/**
 * ==============================================================================
 * MARISLINK: Intelligent Underwater Acoustic Communication & Monitoring System
 * ==============================================================================
 * ACTUAL WOKWI ESP32 FIRMWARE (C/C++)
 * Target Simulator: Wokwi (ESP32 DevKit v1 / board-esp32-devkit-v1)
 *
 * HARDWARE CONFIGURATION & PIN CONNECTIONS:
 *  - BMP180 / BMP280 Sensor: Temperature & Ambient Pressure Transducer [I2C: SDA=GPIO 21, SCL=GPIO 22]
 *  - SSD1306 128x64 OLED: Local underwater node status monitor [I2C: Address 0x3C]
 *  - Potentiometer 1 (ADC GPIO 34): Simulated Battery Voltage Divider (0-3.3V -> 3.0-4.2V LiPo)
 *  - Potentiometer 2 (ADC GPIO 35): Simulated Acoustic Signal Attenuator (0-3.3V -> -95 to -55 dBm RSSI)
 *  - Green LED (GPIO 2): Acoustic TX Burst Transmission Indicator (via 220 Ohm resistor)
 *  - Yellow LED (GPIO 4): Acoustic Synchronization & Carrier Lock (via 220 Ohm resistor)
 *  - Red LED (GPIO 15): Critical Fault / Alert Indicator (via 220 Ohm resistor)
 *
 * PHYSICAL SENSOR VS DEEP-SEA PRESSURE CALIBRATION:
 *  A standard BMP180/BMP280 MEMS sensor measures atmospheric pressures (300-1100 hPa).
 *  Actual deep-sea pressure at 2000m depth is ~20.1 MPa (200 atmospheres).
 *  This firmware reads the true physical transducer value (hPa) and applies an oceanographic
 *  hydrostatic transfer function to model the deep-sea pressure (MPa) and acoustic depth (m),
 *  transmitting BOTH physical transducer and calibrated oceanographic values.
 *
 * DATA SOURCE DISTINCTION:
 *  All readings generated by this firmware are explicitly tagged as:
 *  "source": "wokwi-esp32-firmware"
 *  "firmware_type": "EMBEDDED_C_CPP"
 *  "hardware_execution": "WOKWI_SIMULATED_CHIP"
 * ==============================================================================
 */

#include <Wire.h>
#include <Adafruit_Sensor.h>
#include <Adafruit_BMP085.h>
#include <Adafruit_BMP280.h>
#include <Adafruit_GFX.h>
#include <Adafruit_SSD1306.h>
#include <WiFi.h>
#include <HTTPClient.h>
#include <ArduinoJson.h>

// ── Pin Definitions ───────────────────────────────────────────────────────────
#define PIN_SDA            21
#define PIN_SCL            22
#define PIN_POT_BATTERY    34
#define PIN_POT_SIGNAL     35
#define PIN_LED_TX         2
#define PIN_LED_SYNC       4
#define PIN_LED_ALERT      15

// ── OLED Display Configuration ────────────────────────────────────────────────
#define SCREEN_WIDTH       128
#define SCREEN_HEIGHT      64
#define OLED_RESET         -1
#define OLED_I2C_ADDR      0x3C

// ── BMP Sensor Configurations ─────────────────────────────────────────────────
#define BMP280_I2C_ADDR    0x76

// ── WiFi & Telemetry Gateway Configuration ───────────────────────────────────
// Wokwi simulated WiFi uses "Wokwi-GUEST" with empty password
const char* WIFI_SSID     = "Wokwi-GUEST";
const char* WIFI_PASSWORD = "";

// Supported Ingestion Endpoints:
// In Wokwi with Private Gateway: host.wokwi.internal reaches the host PC running Express
// Fallback: direct localhost for local bridge or LAN IP
const char* BACKEND_WOKWI_URL    = "http://host.wokwi.internal:5000/api/hardware/telemetry";
const char* BACKEND_LOCAL_URL    = "http://localhost:5000/api/hardware/telemetry";

// ── Global Objects ────────────────────────────────────────────────────────────
Adafruit_BMP085 bmp180;
Adafruit_BMP280 bmp280;
Adafruit_SSD1306 display(SCREEN_WIDTH, SCREEN_HEIGHT, &Wire, OLED_RESET);

bool bmp180Available = false;
bool bmp280Available = false;
bool oledAvailable = false;
unsigned long sequenceCounter = 0;
unsigned long lastTelemetryMillis = 0;
const unsigned long TELEMETRY_INTERVAL_MS = 2500; // Send telemetry every 2.5 seconds

// Simulated oceanographic base state for Node ESP32-UW01
const char* NODE_ID = "ESP32-UW01";
const char* DEVICE_NAME = "Wokwi ESP32 Underwater Acoustic Node";
const double NOMINAL_DEPTH_M = 2000.0;     // Nominal deployment depth in meters
const double NOMINAL_TEMP_C  = 3.4;        // Deep ocean isothermal layer (~3.4 C)
const double SEAWATER_DENSITY = 1025.0;    // kg/m^3
const double GRAVITY = 9.80665;            // m/s^2

// Dynamic state variables
double currentBatteryVoltage = 4.12;      // Starting LiPo voltage
double currentBatteryLevel   = 95.5;      // Starting percentage
double currentSignalStrength = -68.0;     // Starting RSSI in dBm
double currentLatencyMs      = 142.0;     // Acoustic round-trip delay
double currentPacketLoss     = 2.4;       // Simulated packet loss %
String currentCommStatus     = "OPTIMAL";
String currentNodeStatus     = "ACTIVE";

void setup() {
  Serial.begin(115200);
  delay(1000);

  Serial.println("\n========================================================");
  Serial.println("   MARISLINK INTELLIGENT UNDERWATER ACOUSTIC SYSTEM    ");
  Serial.println("          ACTUAL WOKWI ESP32 FIRMWARE (C/C++)          ");
  Serial.println("========================================================");
  Serial.print("Node ID            : "); Serial.println(NODE_ID);
  Serial.print("Firmware Execution : WOKWI_SIMULATED_CHIP\n");
  Serial.print("Nominal Depth      : "); Serial.print(NOMINAL_DEPTH_M); Serial.println(" m");
  Serial.println("Measurement Type   : SIMULATED_VIRTUAL_HARDWARE");
  Serial.println("Data Source Tag    : wokwi-esp32-firmware");
  Serial.println("========================================================\n");

  // Configure GPIO pins
  pinMode(PIN_LED_TX, OUTPUT);
  pinMode(PIN_LED_SYNC, OUTPUT);
  pinMode(PIN_LED_ALERT, OUTPUT);
  pinMode(PIN_POT_BATTERY, INPUT);
  pinMode(PIN_POT_SIGNAL, INPUT);

  digitalWrite(PIN_LED_TX, LOW);
  digitalWrite(PIN_LED_SYNC, HIGH); // Steady sync lock ON
  digitalWrite(PIN_LED_ALERT, LOW);

  // Initialize I2C bus
  Wire.begin(PIN_SDA, PIN_SCL);

  // Initialize SSD1306 OLED Display
  if (display.begin(SSD1306_SWITCHCAPVCC, OLED_I2C_ADDR)) {
    oledAvailable = true;
    display.clearDisplay();
    display.setTextSize(1);
    display.setTextColor(SSD1306_WHITE);
    display.setCursor(0, 0);
    display.println("MARISLINK ESP32-UW01");
    display.println("---------------------");
    display.println("SRC: WOKWI FIRMWARE");
    display.println("I2C: BMP Sensor + OLED");
    display.println("Booting System...");
    display.display();
    delay(1000);
  } else {
    Serial.println("[WARN] SSD1306 OLED not found at 0x3C, continuing with Serial.");
  }

  // Initialize Barometric Pressure & Temperature Sensor (BMP180 or BMP280)
  if (bmp180.begin()) {
    bmp180Available = true;
    Serial.println("[INIT] BMP180 barometric sensor detected & initialized successfully.");
  } else if (bmp280.begin(BMP280_I2C_ADDR)) {
    bmp280Available = true;
    Serial.println("[INIT] BMP280 sensor initialized successfully at 0x76.");
  } else {
    Serial.println("[WARN] Hardware BMP sensor not detected on I2C. Using dynamic transducer model.");
  }

  // Connect to Simulated WiFi (Wokwi-GUEST)
  Serial.print("[NET] Connecting to WiFi (SSID: ");
  Serial.print(WIFI_SSID);
  Serial.println(")...");

  WiFi.mode(WIFI_STA);
  WiFi.begin(WIFI_SSID, WIFI_PASSWORD);

  int wifiAttempts = 0;
  while (WiFi.status() != WL_CONNECTED && wifiAttempts < 12) {
    delay(400);
    Serial.print(".");
    digitalWrite(PIN_LED_SYNC, !digitalRead(PIN_LED_SYNC));
    wifiAttempts++;
  }

  if (WiFi.status() == WL_CONNECTED) {
    digitalWrite(PIN_LED_SYNC, HIGH);
    Serial.println("\n[NET] WiFi Connected to Wokwi-GUEST!");
    Serial.print("[NET] IP Address: "); Serial.println(WiFi.localIP());
  } else {
    Serial.println("\n[WARN] Running in autonomous mode (Wokwi IoT Gateway or offline buffer).");
    digitalWrite(PIN_LED_SYNC, HIGH);
  }

  Serial.println("[SYSTEM] Wokwi ESP32 Sensor Node operational. Entering telemetry loop...\n");
}

void loop() {
  unsigned long now = millis();

  if (now - lastTelemetryMillis >= TELEMETRY_INTERVAL_MS) {
    lastTelemetryMillis = now;
    sequenceCounter++;

    // ── 1. Read Physical Sensor Values ────────────────────────────────────────
    double rawTempC = 24.5;
    double rawPressHpa = 1013.25;

    if (bmp180Available) {
      rawTempC = bmp180.readTemperature();
      rawPressHpa = bmp180.readPressure() / 100.0F; // Pa to hPa
    } else if (bmp280Available) {
      rawTempC = bmp280.readTemperature();
      rawPressHpa = bmp280.readPressure() / 100.0F;
    }

    // Microscopic hydrodynamic wave jitter
    double microJitter = (sin(now / 5000.0) * 0.15) + (((rand() % 100) - 50) / 1000.0);
    double tideVariation = (cos(now / 15000.0) * 0.08);

    // Deep-sea temperature calibrated from physical transducer + deep abyssal gradient
    // 0.20 C ocean response per 1.0 C shift on transducer test slider
    double oceanTemperature = NOMINAL_TEMP_C + (rawTempC - 24.5) * 0.20 + microJitter;
    oceanTemperature = round(oceanTemperature * 100.0) / 100.0;

    // Ocean Hydrostatic Pressure Calibration:
    // Physical MEMS: 1013 hPa test baseline.
    // Hydrostatic formula: P = (depth * rho * g) / 10^6  [MPa]
    // 2000m depth -> ~20.104 MPa
    double modeledDepthM = NOMINAL_DEPTH_M + (rawPressHpa - 1013.25) * 2.0 + (sin(now / 7000.0) * 1.8);
    modeledDepthM = round(modeledDepthM * 10.0) / 10.0;

    double oceanPressureMpa = (modeledDepthM * SEAWATER_DENSITY * GRAVITY) / 1000000.0; // in MPa
    oceanPressureMpa += tideVariation;
    oceanPressureMpa = round(oceanPressureMpa * 1000.0) / 1000.0;

    // ── 2. Read Potentiometers / Battery & Signal Attenuators ─────────────────
    int rawPotBattery = analogRead(PIN_POT_BATTERY); // 0 - 4095
    int rawPotSignal  = analogRead(PIN_POT_SIGNAL);  // 0 - 4095

    // Smooth proportional mapping across 0 - 4095 full scale
    double batRatio = (double)rawPotBattery / 4095.0;
    currentBatteryVoltage = 3.00 + (batRatio * 1.20); // 3.00V (empty) to 4.20V (full LiPo)
    currentBatteryVoltage = round(currentBatteryVoltage * 100.0) / 100.0;
    currentBatteryLevel = round(batRatio * 100.0 * 10.0) / 10.0;

    // Acoustic signal strength (RSSI): Map 0-4095 to -95 dBm to -55 dBm
    double sigRatio = (double)rawPotSignal / 4095.0;
    currentSignalStrength = -95.0 + (sigRatio * 40.0);
    currentSignalStrength = round(currentSignalStrength * 10.0) / 10.0;

    // Acoustic latency & loss dynamically dependent on RSSI
    if (currentSignalStrength < -82.0) {
      currentPacketLoss = 7.5 + ((rand() % 30) / 10.0);
      currentLatencyMs = 240.0 + (sin(now / 4000.0) * 25.0);
    } else {
      currentPacketLoss = 1.8 + ((rand() % 15) / 10.0);
      currentLatencyMs = 135.0 + (NOMINAL_DEPTH_M / 1500.0 * 10.0) + (sin(now / 4000.0) * 6.0);
    }
    currentLatencyMs = round(currentLatencyMs * 10.0) / 10.0;
    currentPacketLoss = round(currentPacketLoss * 10.0) / 10.0;

    // Health and Status Classification
    if (currentBatteryLevel < 20.0 || currentPacketLoss > 10.0 || currentLatencyMs > 280.0) {
      currentCommStatus = "CRITICAL";
      currentNodeStatus = "CRITICAL";
      digitalWrite(PIN_LED_ALERT, HIGH);
      digitalWrite(PIN_LED_SYNC, (now / 250) % 2 == 0 ? HIGH : LOW);
    } else if (currentBatteryLevel < 35.0 || currentPacketLoss > 5.0 || currentLatencyMs > 180.0) {
      currentCommStatus = "DEGRADED";
      currentNodeStatus = "WARNING";
      digitalWrite(PIN_LED_ALERT, (now / 500) % 2 == 0 ? HIGH : LOW);
      digitalWrite(PIN_LED_SYNC, HIGH);
    } else {
      currentCommStatus = "OPTIMAL";
      currentNodeStatus = "ACTIVE";
      digitalWrite(PIN_LED_ALERT, LOW);
      digitalWrite(PIN_LED_SYNC, HIGH);
    }

    // ── 3. Update SSD1306 OLED Display (High-Clarity Reviewer Layout) ───────────
    if (oledAvailable) {
      display.clearDisplay();

      // 1. Inverted Header Bar
      display.fillRect(0, 0, 128, 11, SSD1306_WHITE);
      display.setTextSize(1);
      display.setTextColor(SSD1306_BLACK, SSD1306_WHITE);
      display.setCursor(2, 2);
      display.print("MARISLINK ");
      display.print(NODE_ID);
      display.setCursor(94, 2);
      display.printf("#%03lu", sequenceCounter % 1000);

      // 2. High-Visibility Temperature (Transducer & Calibrated)
      display.setTextColor(SSD1306_WHITE);
      display.setCursor(0, 14);
      display.print("RAW TEMP: ");
      display.printf("%.1f C", rawTempC);

      display.setCursor(0, 24);
      display.print("OCEAN T : ");
      display.printf("%.2f C (2000m)", oceanTemperature);

      // 3. Pressure & Depth
      display.setCursor(0, 34);
      display.printf("PRES: %.2fMPa (%dhPa)", oceanPressureMpa, (int)rawPressHpa);

      // 4. Battery Level & Visual Meter
      display.setCursor(0, 44);
      display.printf("BAT: %.2fV [%3d%%] ", currentBatteryVoltage, (int)currentBatteryLevel);
      int barWidth = (int)((currentBatteryLevel / 100.0) * 16.0);
      if (barWidth < 0) barWidth = 0;
      if (barWidth > 16) barWidth = 16;
      display.drawRect(108, 44, 18, 7, SSD1306_WHITE);
      display.fillRect(110, 46, barWidth, 3, SSD1306_WHITE);

      // 5. Acoustic Signal & Operational State
      display.setCursor(0, 54);
      display.printf("SIG:%ddB [%s]", (int)currentSignalStrength, currentCommStatus.c_str());

      // Blinking live heartbeat pixel in corner
      if ((sequenceCounter % 2) == 0) {
        display.fillRect(124, 55, 3, 3, SSD1306_WHITE);
      }

      display.display();
    }

    // ── 4. Log Formatted Reading to Serial Monitor ────────────────────────────
    Serial.println("----------------------------------------------------------------");
    Serial.printf("[WOKWI TELEMETRY #%lu] Node: %s | Source: wokwi-esp32-firmware\n",
                  sequenceCounter, NODE_ID);
    Serial.printf("  Ocean Temp    : %.2f C  (Raw Transducer: %.2f C)\n", oceanTemperature, rawTempC);
    Serial.printf("  Ocean Press   : %.3f MPa [Calibrated Hydrostatic at %.1f m]\n", oceanPressureMpa, modeledDepthM);
    Serial.printf("  Raw Transducer: %.2f hPa (Physical Atmospheric Sensor)\n", rawPressHpa);
    Serial.printf("  Battery State : %.2f V (%.1f%%) | Acoustic RSSI: %.1f dBm\n",
                  currentBatteryVoltage, currentBatteryLevel, currentSignalStrength);
    Serial.printf("  Acoustic Link : Latency %.1f ms | Packet Loss: %.1f%%\n",
                  currentLatencyMs, currentPacketLoss);

    // ── 5. Flash Green TX Burst LED ──────────────────────────────────────────
    digitalWrite(PIN_LED_TX, HIGH);

    // ── 6. Assemble JSON Telemetry Payload ────────────────────────────────────
    StaticJsonDocument<512> doc;
    doc["node_id"]              = NODE_ID;
    doc["device_name"]          = DEVICE_NAME;
    doc["sequence"]             = sequenceCounter;
    doc["depth_m"]              = modeledDepthM;
    doc["temperature_c"]        = oceanTemperature;
    doc["pressure_mpa"]         = oceanPressureMpa;
    doc["raw_sensor_hpa"]       = rawPressHpa;
    doc["battery_voltage_v"]    = currentBatteryVoltage;
    doc["battery_level"]        = currentBatteryLevel;
    doc["signal_strength"]      = currentSignalStrength;
    doc["latency_ms"]           = currentLatencyMs;
    doc["packet_loss"]          = currentPacketLoss;
    doc["communication_status"] = currentCommStatus;
    doc["node_status"]          = currentNodeStatus;
    doc["source"]               = "wokwi-esp32-firmware";
    doc["source_label"]         = "ACTUAL WOKWI FIRMWARE TELEMETRY";
    doc["is_actual_wokwi"]      = true;
    doc["firmware_type"]        = "EMBEDDED_C_CPP";
    doc["hardware_execution"]   = "WOKWI_SIMULATED_CHIP";
    doc["calibration_model"]    = "BMP_ATMOSPHERIC_TO_HYDROSTATIC_TRANSFER_FN";

    String payloadString;
    serializeJson(doc, payloadString);

    // ── 7. Dispatch HTTP Telemetry to MARISLINK Backend ───────────────────────
    if (WiFi.status() == WL_CONNECTED) {
      HTTPClient http;
      http.begin(BACKEND_WOKWI_URL);
      http.addHeader("Content-Type", "application/json");
      http.setTimeout(2000);

      int httpResponseCode = http.POST(payloadString);
      if (httpResponseCode >= 200 && httpResponseCode < 300) {
        Serial.printf("  [HTTP DISPATCH] Success (HTTP %d) via host.wokwi.internal\n", httpResponseCode);
      } else {
        // Fallback try local
        HTTPClient httpLocal;
        httpLocal.begin(BACKEND_LOCAL_URL);
        httpLocal.addHeader("Content-Type", "application/json");
        httpLocal.setTimeout(1500);
        int localCode = httpLocal.POST(payloadString);
        if (localCode >= 200 && localCode < 300) {
          Serial.printf("  [HTTP DISPATCH] Success (HTTP %d) via localhost\n", localCode);
        } else {
          Serial.printf("  [HTTP DISPATCH] Awaiting Wokwi Gateway connection (HTTP %d / %d)\n", httpResponseCode, localCode);
        }
        httpLocal.end();
      }
      http.end();
    } else {
      Serial.println("  [BUFFERED] Telemetry packet held in simulated transponder buffer.");
    }

    delay(80); // TX LED pulse width
    digitalWrite(PIN_LED_TX, LOW);
  }

  delay(20);
}
